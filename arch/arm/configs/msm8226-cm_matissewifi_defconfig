## arch/arm/configs/msm8226-cm_matissewifi_defconfig
```kconfig
#variant defconfig
CONFIG_MACH_MATISSEWIFI_OPEN=y
CONFIG_SEC_MATISSE_PROJECT=y
CONFIG_SEC_MATISSEWIFI_COMMON=y

# IRDA devices
CONFIG_IR_REMOCON_MC96FR116=y

# TIMA LOG
CONFIG_ARCH_MSM8226_3G_WIFI=y

# SSWAP
CONFIG_SWAP=y
CONFIG_FRONTSWAP=y
CONFIG_ZSMALLOC_NEW=y
CONFIG_PGTABLE_MAPPING=y
CONFIG_ZSWAP=y
CONFIG_DIRECT_RECLAIM_FILE_PAGES_ONLY=n
CONFIG_INCREASE_MAXIMUM_SWAPPINESS=y
CONFIG_FIX_INACTIVE_RATIO=y
CONFIG_TIGHT_PGDAT_BALANCE=y
CONFIG_VNSWAP=y
CONFIG_SWAP_ENABLE_READAHEAD=n
```

## arch/arm/configs/msm8226-sec_fbconsole_defconfig
```kconfig
#variant defconfig
CONFIG_MACH_MATISSEWIFI_OPEN=y
CONFIG_SEC_MATISSE_PROJECT=y
CONFIG_SEC_MATISSEWIFI_COMMON=y

#
#CONFIG_CMDLINE="console=tty0,115200 fbcon=rotate:1 fbcon=font:VGA8x8"
##CONFIG_CMDLINE="mem=109M diag=arm9 fbcon=rotate:1 fbcon=font:VGA8x8"
#CONFIG_CMDLINE_FORCE=y

## CONFIG_FB_MSM_LOGO is not set
## CONFIG_FB_MSM_SEC_BOOTLOGO is not set
#CONFIG_FRAMEBUFFER_CONSOLE_ROTATION=y

## CONFIG_FONT_8x16 is not set
## CONFIG_PRINTK_TIME is not set

#CONFIG_VT=y
#CONFIG_DUMMY_CONSOLE=y
#CONFIG_FRAMEBUFFER_CONSOLE=y
#CONFIG_FRAMEBUFFER_CONSOLE_DETECT_PRIMARY=y
#CONFIG_FRAMEBUFFER_CONSOLE_ROTATION=y
#CONFIG_FONTS=y
#CONFIG_FONT_8x8=y
#CONFIG_FONT_8x16=y
#CONFIG_LOGO=y
#CONFIG_LOGO_LINUX_MONO=y
```

## arch/arm/configs/msm8926-cm_matisselte_defconfig
```kconfig
#variant defconfig
CONFIG_MACH_MATISSELTE_OPEN=y
CONFIG_SEC_MATISSE_PROJECT=y
CONFIG_SEC_MATISSELTE_COMMON=y

#VIBRATOR
#CONFIG_QPNP_VIBRATOR is not set
#CONFIG_MSM_VIBRATOR=y
CONFIG_HAPTIC_ISA1200=y

#SENSOR
CONFIG_SENSORS=y
CONFIG_SENSORS_K2HH=y
CONFIG_SENSORS_SX9500=y
CONFIG_SENSORS_SX9500_INIT_TOUCH_THRESHOLD=3000
CONFIG_SENSORS_SX9500_NORMAL_TOUCH_THRESHOLD=15

# TIMA LOG
CONFIG_ARCH_MSM8926_LTE=y

# SSWAP
CONFIG_SWAP=y
CONFIG_FRONTSWAP=y
CONFIG_ZSMALLOC_NEW=y
CONFIG_PGTABLE_MAPPING=y
CONFIG_ZSWAP=y
CONFIG_DIRECT_RECLAIM_FILE_PAGES_ONLY=n
CONFIG_INCREASE_MAXIMUM_SWAPPINESS=y
CONFIG_FIX_INACTIVE_RATIO=y
CONFIG_TIGHT_PGDAT_BALANCE=y
CONFIG_VNSWAP=y
CONFIG_SWAP_ENABLE_READAHEAD=n
```
